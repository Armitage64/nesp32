## firmware/main/Kconfig.projbuild
```kconfig
menu "nesp32"

config NESP_DISPLAY_FLIPPED
    bool "Turn the screen upside down"
    default y
    help
        On, the screen is drawn a half turn round from M5Stack's landscape
        (rotation 3). Off draws it M5Stack's way up again (rotation 1).
        This is the way up until a console chooses one (Flip LCD in
        Setup, SYS SCREEN), which the nesp32 then keeps in NVS.

config NESP_LINK_INVERTED
    bool "The link to the console inverts"
    default y
    help
        On for the nesp32 hat, whose NPN stages each invert (or the
        SN74LV1T04 inverters in their place): the UART inverts TX and RX to
        cancel them. Off for a link that does not invert, such as the three
        resistors on an ESP32-S3 board; sdkconfig.defaults.generic turns it
        off. docs/WIRING.md has each circuit.

endmenu
```
